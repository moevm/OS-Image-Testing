## conf/local.conf
```bitbake
MACHINE ??= "qemux86-64"

DL_DIR ?= "/home/user/poky/downloads"

SSTATE_DIR ?= "/home/user/poky/sstate-cache${TOPDIR}/sstate-cache"

DISTRO ?= "poky"

INIT_MANAGER = "systemd"

PACKAGE_CLASSES ?= "package_rpm"

IMAGE_FEATURES += "serial-autologin-root empty-root-password package-management"

IMAGE_FSTYPES += "ext4.qcow2"

USER_CLASSES ?= "buildstats"

PATCHRESOLVE = "noop"

BB_DISKMON_DIRS ??= "\
    STOPTASKS,${TMPDIR},1G,100K \
    STOPTASKS,${DL_DIR},1G,100K \
    STOPTASKS,${SSTATE_DIR},1G,100K \
    STOPTASKS,/tmp,100M,100K \
    HALT,${TMPDIR},100M,1K \
    HALT,${DL_DIR},100M,1K \
    HALT,${SSTATE_DIR},100M,1K \
    HALT,/tmp,10M,1K"

PACKAGECONFIG:append:pn-qemu-system-native = " fdt"
PACKAGECONFIG:append:pn-systemd = " pcre2"

CONF_VERSION = "2"

DISTRO_FEATURES:append = " \
    integrity \
    ipv6 \
    pam \
    ptest \
    security \
    virtualization \
"

# 8Gb
IMAGE_ROOTFS_EXTRA_SPACE = "8388608"

THREADS_AMOUNT = "3"

BB_NUMBER_THREADS = "${THREADS_AMOUNT}"

PARALLEL_MAKE = "-j ${THREADS_AMOUNT}"

BB_SERVER_TIMEOUT = "600"

CONNECTION_TIMEOUT = "600"

PKG_CONFIG_PATH:append = ":${STAGING_LIBDIR_NATIVE}/pkgconfig"

OECORE_NATIVE_SYSROOT = "${STAGING_DIR_NATIVE}"

DEPENDS:append:pn-iproute2 = " libtirpc"

EXTRA_USERS_PARAMS = "usermod -p '*' root;"

EXTRA_IMAGE_FEATURES += "ssh-server-openssh allow-root-login allow-empty-password"

# Uncomment for more tests
# EXTRA_IMAGE_FEATURES += "ptest-pkgs"

SKIP_META_VIRT_SANITY_CHECK = "1"

# 3Gb RAM
QB_MEM = "-m 3072"

# CPU 4 cores
QB_CPU = "-smp 4"

require packages.conf

require added_packages.conf
```

## layers/meta-image-tests/conf/layer.conf
```bitbake
BBPATH := "${BBPATH}:${LAYERDIR}"

BBFILES += "${LAYERDIR}/recipes-*/*/*.bb \
            ${LAYERDIR}/recipes-*/*/*.bbappend"

BBFILE_COLLECTIONS += "meta-image-tests"
BBFILE_PATTERN_meta-image-tests = "^${LAYERDIR}/"
BBFILE_PRIORITY_meta-image-tests = "6"

LAYERDEPENDS_meta-image-tests = "core"
LAYERSERIES_COMPAT_meta-image-tests = "walnascar"
```

## layers/meta-mytests/conf/layer.conf
```bitbake
BBPATH .= ":${LAYERDIR}"

BBFILES += "${LAYERDIR}/recipes-*/*/*.bb \
            ${LAYERDIR}/recipes-*/*/*.bbappend"

BBFILE_COLLECTIONS += "mytests"

BBFILE_PATTERN_mytests = "^${LAYERDIR}/"

BBFILE_PRIORITY_mytests = "6"

LAYERVERSION_mytests = "1"

LAYERSERIES_COMPAT_mytests = "styhead kirkstone warrior zeus"
```
